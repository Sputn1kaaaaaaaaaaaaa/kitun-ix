## ZNU/Kconfig
```kconfig
mainmenu "ZNU Kernel Configuration"

source "boot/Kconfig"
source "core/Kconfig"
source "drivers/Kconfig"
```

## ZNU/core/Kconfig
```kconfig
menu "core"

source "core/graphics/Kconfig"

comment "No options in this menu yet"

endmenu
```

## ZNU/drivers/keyboard/Kconfig
```kconfig
menu "keyboard"

comment "PS/2 keyboard driver"
comment "This driver provides a minimal scancode interface for future input handling."

endmenu
```
